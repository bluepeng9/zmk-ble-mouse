## Kconfig
```kconfig
config ZMK_BEHAVIOR_BLE_MOUSE
    bool
    default y if DT_HAS_ZMK_BEHAVIOR_BLE_MOUSE_ENABLED

config ZMK_BLE_MOUSE_CENTRAL
    bool "Receive a bonded BLE HID mouse on the split dongle"
    depends on ZMK_SPLIT_BLE && ZMK_SPLIT_ROLE_CENTRAL && ZMK_POINTING
    depends on BT_SMP && SETTINGS
    depends on DT_HAS_ZMK_BLE_MOUSE_RECEIVER_ENABLED
    depends on !BT_FILTER_ACCEPT_LIST
    select BT_GATT_CLIENT
    help
      Uses a free connection and bond within the existing Bluetooth limits.
      Does not change the PC profile count or evict existing bonds.
      When split battery fetching is enabled, a module-owned linker wrapper
      rejects invalid battery source IDs before calling the original ZMK
      event handler. The upstream sources and battery setting stay intact.

if ZMK_BLE_MOUSE_CENTRAL

config ZMK_BLE_MOUSE_LEGACY_PAIRING
    bool "Allow Legacy pairing for the explicitly selected mouse"
    default y
    depends on BT_SMP_SC_PAIR_ONLY && BT_SMP_APP_PAIRING_ACCEPT && BT_SETTINGS
    help
      Include Legacy SMP support using a module-owned compiler header.
      Restrict Legacy pairing to a new mouse during the Pair window and
      retain the application's authentication callbacks for every connection.
      Adapt old SC-only bond records on read, without rewriting them at boot.
      Requires the reviewed Zephyr 3.5 host/settings interfaces and GNU wrapping.
      Authentication callback removal and per-connection overlays are refused
      while this compatibility layer is enabled. See README for build checks.

config ZMK_BLE_MOUSE_STACK_SIZE
    int "BLE mouse control thread stack size"
    default 4096

config ZMK_BLE_MOUSE_QUEUE_SIZE
    int "BLE mouse input queue length"
    range 8 128
    default 32

config ZMK_BLE_MOUSE_LOG_LEVEL
    int "BLE mouse log level (0 off, 1 errors, 2 warnings, 3 info, 4 debug)"
    range 0 4
    default 3

endif
```

## dts/bindings/behaviors/zmk,behavior-ble-mouse.yaml
```yaml
description: Pair a BLE mouse or clear only its bond after a two-second hold
compatible: "zmk,behavior-ble-mouse"
include: one_param.yaml
```

## dts/bindings/zmk,ble-mouse-receiver.yaml
```yaml
description: BLE HID mouse receiver exposed as a Zephyr input device
compatible: "zmk,ble-mouse-receiver"
include: base.yaml
```
